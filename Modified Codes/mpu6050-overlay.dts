/dts-v1/;
/plugin/;

/ {
    compatible = "ti,beaglebone", "ti,beaglebone-black";

    /*
     * MPU6050 IMU on I2C2
     * INT connected to GPIO1_28
     */
    fragment@0 {
        target = <&i2c2>;
        __overlay__ {
            #address-cells = <1>;
            #size-cells = <0>;
            status = "okay";

            mpu6050@68 {
                compatible = "senseedge,mpu6050";
                reg = <0x68>;

                /* Interrupt configuration */
                interrupt-parent = <&gpio1>;
                interrupts = <28 IRQ_TYPE_EDGE_RISING>;

                /* Runtime configuration */
                sampling-rate-hz = <100>;      /* Output data rate */
                accel-range = <2>;             /* ±2g */
                gyro-range  = <250>;           /* ±250 dps */

                /* Power supply (dummy or real regulator) */
                vdd-supply = <&vdd_3v3_sys>;

                status = "okay";
            };
        };
    };
};