/dts-v1/;
/plugin/;

/ {
    compatible = "ti,beaglebone", "ti,beaglebone-black";

    fragment@0 {
        target = <&i2c2>;
        __overlay__ {
            #address-cells = <1>;
            #size-cells = <0>;
            status = "okay";

            mpu6050@68 {
                compatible = "senseedge,mpu6050";
                reg = <0x68>;

                /* GPIO1_28 -> P9_12, rising edge */
                interrupt-parent = <&gpio1>;
                interrupts = <28 0x01>;

                sampling-rate-hz = <100>;
                accel-range = <2>;
                gyro-range  = <250>;

                status = "okay";
            };
        };
    };
};
