/dts-v1/;
/plugin/;

/ {
    compatible = "ti,beaglebone", "ti,beaglebone-black";

    fragment@0 {
        target = <&i2c2>;
        __overlay__ {
            #address-cells = <1>;
            #size-cells = <0>;
            status = "okay";

            mpu6050@68 {
                compatible = "SenseEdge,mpu6050";
                reg = <0x68>;

                interrupt-parent = <&gpio1>;
                interrupts = <28 1>; /* GPIO1_28, rising edge */

                status = "okay";
            };
        };
    };
};

